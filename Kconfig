## Kconfig
```kconfig
#
# For a description of the syntax of this configuration file,
# see Documentation/kbuild/kconfig-language.txt.
#
mainmenu "Linux/$ARCH $KERNELVERSION Kernel Configuration"

config T93_PROJ
	bool "T93_PROJ"
	default n
config SRCARCH
	string
	option env="SRCARCH"

# add by hct start
source "Kconfig.hct.common"
source "Kconfig.hct.t255"
source "Kconfig.hct.t925"
source "Kconfig.hct.t93"
source "Kconfig.hct.t985"
source "Kconfig.hct.t89"
source "Kconfig.hct.t99"
source "Kconfig.hct.t96"
source "Kconfig.hct.t87"
source "Kconfig.hct.t875"
source "Kconfig.hct.t825"
source "Kconfig.hct.t823"
source "Kconfig.hct.t525"
# add by hct end
source "arch/$SRCARCH/Kconfig"
```

## Kconfig.hct.common
```kconfig
config HCT_DEVICE_INFO_SUPPORT
	bool "HCT DEVICE INFO SUPPORT"
	default n

config TPD_PROXIMITY
	bool "TPD_PROXIMITY"
	default n

config FINGERPRINT_ET300
	bool "HCT FINGERPRINT_ET300 SUPPORT"
	default n

config FINGERPRINT_ET310
	bool "HCT FINGERPRINT_ET310 SUPPORT"
	default n

config FINGERPRINT_FPS1196
	bool "HCT FINGERPRINT_FPS1196 SUPPORT"
	default n

config HCT_FINGERPRINT_SUPPORT
	bool "HCT HCT_FINGERPRINT_SUPPORT"
	default n

config FINGERPRINT_SILEADE
	bool "HCT FINGERPRINT_SILEADE SUPPORT"
	default n

config FINGERPRINT_SILEADE_6162
	bool "HCT FINGERPRINT_SILEADE_6162 SUPPORT"
	default n
	
config FINGERPRINT_GF318M_GOODIX
	bool "HCT FINGERPRINT_GF318M_GOODIX SUPPORT"
	default n

config FINGERPRINT_NEWSCHIP
	bool "HCT FINGERPRINT_NEWSCHIP SUPPORT"
	default n

config FINGERPRINT_JMT103
	bool "HCT FINGERPRINT_JMT103 SUPPORT"
	default n

config FINGERPRINT_SF115
	bool "HCT FINGERPRINT_SF115 SUPPORT"
	default n

config FINGERPRINT_SF115_OLD
	bool "HCT FINGERPRINT_SF115_OLD SUPPORT"
	default n

config FINGERPRINT_AFS120
	bool "HCT FINGER MARIWEI SUPPORT"
	default n
	
config HIGH_BATTERY_VOLTAGE_SUPPORT
	bool "HCT HIGH_BATTERY_VOLTAGE_SUPPORT"
	default n

config CAMERA_SHOT_SUPPORT
	bool "HCT CONFIG_CAMERA_SHOT_SUPPORT"
	default n
config HCT_TP_GESTRUE
	bool "CONFIG_HCT_TP_GESTRUE"
	default n
config AW8736_MODE_CTRL
	bool "AW8736_MODE_CTRL"
	default n

config HCT_GTP_HALL_CFG
	bool "HCT TP USER DEFERENT CONFIG RELAY ON HALL STATUS"
	default n
	
config HCT_LED_SGM3785
	bool "HCT CONFIG_HCT_LED_SGM3785"
	default n
config MTK_DUMMY_PS
	bool "HCT MTK_DUMMY_PS"
	default n

config HCT_AF_POWER_ON_NOISE
	bool "HCT HCT_AF_POWER_ON_NOISE af dvdd power on in sensor driver to avoid noise"
	default n
	
config NCP1854_DUAL_SUPPORT
        bool "CONFIG_NCP1854_DUAL_SUPPORT config dual ncp1854 support"
        default n

config HCT_LETTICE_SUPPORT
        bool "CONFIG_HCT_LETTICE_SUPPORT config lettice chip support"
        default n
	
config LETTICE_VD_SUPPORT
        bool "CONFIG_LETTICE_VD_SUPPORT config lettice voice wakeup feature support"
        default n

config S5K3M2_USE_AWB_OTP
        bool "config S5K3M2_USE_AWB_OTP support"
        default n

config NCP1854_DUAL_SUPPORT
        bool "CONFIG_NCP1854_DUAL_SUPPORT config dual ncp1854 support"
        default n

config HCT_FIXBUG_ESD_FLICKER
        bool "HCT_FIXBUG_ESD_FLICKER fixbug: esd cause flicker"
        default n

config HIGH_4400_BATTERY_VOLTAGE_SUPPORT
        bool "HIGH_4400_BATTERY_VOLTAGE_SUPPORT support 4.4V battery"
        default n

config MTK_AP3XX6_NEW
        bool "CONFIG_MTK_AP3XX6_NEW config new alsps ap3xx6 support"
        default n
config AW9136_SUPPORT
        bool "CONFIG_AW9136_SUPPORT TP BUTTON CHIP config AW9136_SUPPORT support"
        default n

config HCT_SMART_KEY_DETECT_SUPPORT
        bool "CONFIG_HCT_SMART_KEY_DETECT_SUPPORT config yuxin super accdet support"
        default n

config HCT_NCP_HIGHER_CV
	bool "CONFIG_HCT_NCP_HIGHER_CV config ncp1854 higher voltage support"
        default n

config AW_FLASH_LED_LONGTIME_SUPPORT
        bool "HCT AW_FLASH_LED_LONGTIME_SUPPORT"
        default n	

config HCT_LCM_ESD_SUPPORT_LONG_PACKET
        bool "HCT_LCM_ESD_SUPPORT_LONG_PACKET support"
        default n

config HCT_BATTERY_IMPROVE
        bool "HCT_BATTERY_IMPROVE support"
        default n

config HX8394_ESD_OPEN
        bool "HX8394_ESD_OPEN support"
        default n

config CHIP_BREATHLIGHT_SUPPORT
        bool "CHIP_BREATHLIGHT_SUPPORT support"
        default n

config AW9106B_BREATH_SUPPORT
        bool "AW9106B_BREATH CHIP SUPPORT support"
        default n

config AW2103_BREATH_SUPPORT
        bool "AW2103_BREATH CHIP SUPPORT support"
        default n

config HCT_REMOVE_SIM_HOT_PLUG
        bool "HCT_REMOVE_SIM_HOT_PLUG support"
        default n

config HCT_REMOVE_SD_HOT_PLUG
        bool "HCT_REMOVE_SD_HOT_PLUG support"
        default n

config HCT_SUPPORT_ONEKEY_RST_8SEC
		bool "HCT_SUPPORT_ONEKEY_RST_8SEC support"
        default n

config HCT_BATTERY_IMPROVE
		bool "HCT_BATTERY_IMPROVE support"
        default n
config GSENSOR_ESD_CHECK_NEW_SUPPORT
		bool "GSENSOR_ESD_CHECK_NEW support"
        default n
```

## Kconfig.hct.t823
```kconfig
config T823_PROJ
	bool "T823_PROJ"
	default n

config T823K_CQ_PROJ
	bool "T823K_CQ_PROJ"
	default n

config T823A_DH_PROJ
	bool "T823A_DH_PROJ"
	default n

config T823S_NYX_PROJ
	bool "T823S_NYX_PROJ"
	default n

config T823Z_HW_PROJ
	bool "T823Z_HW_PROJ"
	default n

config T823T_HS_PROJ
	bool "T823T_HS_PROJ"
	default n

config T823AM_JKA6_PROJ
	bool "T823AM_JKA6_PROJ"
	default n

config T823AC_JYKJ_PROJ
	bool "T823AC_JYKJ_PROJ"
	default n

config T823AH_JYKJ_PROJ
	bool "T823AH_JYKJ_PROJ"
	default n

config T823AE_HK_PROJ
	bool "T823AE_HK_PROJ"
	default n

config T823AQ_HK_PROJ
	bool "T823AQ_HK_PROJ"
	default n

config T823AB_CQ_PROJ
	bool "T823AB_CQ_PROJ"
	default n

config T823Y_BL_PROJ
	bool "T823Y_BL_PROJ"
	default n

config T823B_YS_PROJ
	bool "T823B_YS_PROJ"
	default n

config T823D_LF_PROJ
	bool "T823D_LF_PROJ"
	default n

config T823L_NYX_PROJ
	bool "T823L_NYX_PROJ"
	default n

config T823N_YS_PROJ
	bool "T823N_YS_PROJ"
	default n

config T823X_WH_PROJ
	bool "T823X_WH_PROJ"
	default n
```

## Kconfig.hct.t825
```kconfig
config T825_PROJ
	bool "T825_PROJ"
	default n

config T825A_DH_PROJ
	bool "T825A_DH_PROJ"
	default n
	
config T825B_YS_PROJ
	bool "T825B_YS_PROJ"
	default n
	
config T825C_YX_PROJ
	bool "T825C_YX_PROJ"
	default n
	
config T825D_LF_PROJ
	bool "T825D_LF_PROJ"
	default n
		
config T825F_YG_PROJ
	bool "T825F_YG_PROJ"
	default n
	
config T825G_PL_PROJ
	bool "T825G_PL_PROJ"
	default n
	
config T825H_BL11_PROJ
	bool "T825H_BL11_PROJ"
	default n
	
config T825K_CQ_PROJ
	bool "T825K_CQ_PROJ"
	default n
	
config T825N_YS_PROJ
	bool "T825N_YS_PROJ"
	default n
		
config T825P_BL12_PROJ
	bool "T825P_BL12_PROJ"
	default n
	
```

## Kconfig.hct.t87
```kconfig
config T87_PROJ
	bool "T87_PROJ"
	default n
	
	
config T87A_OQ_PROJ
	bool "T87A_OQ_PROJ"
	default n

config T87E_CQ_PROJ
	bool "T87E_CQ_PROJ"
	default n
```

## Kconfig.hct.t875
```kconfig
config T875_PROJ
	bool "T875_PROJ"
	default n

config T875B_HS_PROJ
	bool "T875_HS_PROJ"
	default n
	
config T875C_DG_PROJ
	bool "CONFIG_T875C_DG_PROJ"
	default n

config T875A_T92_PROJ
	bool "CONFIG_T875A_T92_PROJ"
	default n

config T875F_T95_PROJ
	bool "CONFIG_T875F_T95_PROJ"
	default n

config T875D_GQ_PROJ
	bool "CONFIG_T875D_GQ_PROJ"
	default n

config T875K_S02_PROJ
	bool "CONFIG_T875K_S02_PROJ"
	default n
```

## Kconfig.hct.t89
```kconfig
config T89_PROJ
	bool "T89_PROJ"
	default n

config T89P_YX_PROJ
	bool "T89P_YX_PROJ"
	default n

config T89B_OTD_PROJ
	bool "T89B_OTD_PROJ"
	default n

config T89P_HD_PROJ
	bool "T89P_YX_PROJ"
	default n

config T89G_TX_PROJ
	bool "T89G_TX_PROJ"
	default n
```

## Kconfig.hct.t925
```kconfig
config T925_PROJ
	bool "T925_PROJ"
	default n

config T925_TIEPIAN
	bool "T925_TIEPIAN"
	default n

config T925D_NYX_M18
	bool "T925D_NYX_M18"
	default n

config T925M_DH_PROJ
	bool "T925M_DH_PROJ"
	default n

config T925G_KW_PROJ
	bool "T925G_KW_PROJ"
	default n

config T925H_KW_PROJ
	bool "T925H_KW_PROJ"
	default n

config T925J_YX
	bool "T925J_YX"
	default n

config T925C_LG
	bool "T925C_LG"
	default n

config T925R_HAIDI_P700
	bool "T925R_HAIDI_P700"
	default n

config T925AC_HAIDI_P710
	bool "T925AC_HAIDI_P710"
	default n

config T925F_AZYP_PROJ
	bool "T925F_AZYP_PROJ"
	default n

config T925U_YS_T925
	bool "T925U_YS_T925"
	default n

config T925X_YS_T925
	bool "T925X_YS_T925"
	default n

config T925AB_QZ_PROJ
	bool "T925AB_QZ_PROJ"
	default n

config T925T_DG_PROJ
	bool "T925T_DG_PROJ"
	default n

config T925W_ZZB_PROJ
	bool "T925W_ZZB_PROJ"
	default n
```

## Kconfig.hct.t93
```kconfig
config RGB_LED_SUPPORT
	bool "RGB_LED_SUPPORT"
	default n

config T93E_TS_PROJ
	bool "T93E_TS_PROJ"
	default n

config T93F_ANZHI_PROJ
	bool "T93F_ANZHI_PROJ"
	default n

config T93A_PROJ
	bool "T93A_PROJ"
	default n

config T93Q_LF_PROJ
	bool "T93Q_LF_PROJ"
	default n

config T93H_KLT_PROJ
	bool "T93H_KLT_PROJ"
	default n
	
config T93K_PROJ
	bool "T93k_PROJ"
	default n

config T933_PROJ
	bool "T933_PROJ"
	default n

config T935_PROJ
	bool "T933_PROJ"
	default n

config T935D_PROJ
	bool "T933_PROJ"
	default n

config T933BA_PROJ
	bool "T933BA_PROJ"
	default n

config T935BO_PROJ
	bool "T935BO_PROJ"
	default n

config T935K_PROJ
	bool "T93k_PROJ"
	default n

config T93AB_PROJ
	bool "T93AB_PROJ"
	default n

config T935T_DK_PROJ
	bool "T935T_DK_PROJ"
	default n
	
config T93P_DK_PROJ
	bool "T93P_DK_PROJ"
	default n

config T935T_DK_PROJ
	bool "T935T_DK_PROJ"
	default n
```

## Kconfig.hct.t96
```kconfig
config T96_PROJ
	bool "T96_PROJ"
	default n

#customer
config T96_YS_PROJ
	bool "T96_YS_PROJ"
	default n

config T96_HD_PROJ
	bool "T96_YS_PROJ"
	default n
```

## Kconfig.hct.t985
```kconfig
config T985_PROJ
	bool "T985_PROJ"
	default n

config T985D_HD_PROJ
	bool "T985_PROJ"
	default n

config T985C_CH
	bool "T985C_CH"
	default n
```

## Kconfig.hct.t99
```kconfig
config T99_PROJ
	bool "T99_PROJ"
	default n

config T99H_HAIER_PROJ
	bool "T99H_HAIER_PROJ"
	default n

config T99H_OUQI_PROJ
	bool "T99H_OUQI_PROJ"
	default n

config T99L_DWS_PROJ
	bool "T99L_DWS_PROJ"
	default n

config T99F_LF_PROJ
	bool "T99F_LF_PROJ"
	default n

config T991_PROJ
	bool "T991_PROJ"
	default n

config T99C_JQ_PROJ
	bool "T99C_JQ_PROJ"
	default n
```

## drivers/misc/mediatek/fingerprint/afs120/Kconfig
```kconfig
# Finger configuration
menuconfig INPUT_FINGER
	bool "Finger devices"
	default y
	help
	Say Y here, and a list of supported finger will be displayed.
	This option doesn't affect the kernel.
	If unsure, say Y.

if INPUT_FINGER
config FINGER_MA
	tristate "fingerprints"
	depends on SPI
	default y
	---help---
	Say Y here if you want to supports when some keys are pressed;
	To compile this driver as a module, choose M here: the
	module will be called afs120.
	If unsure, say Y.
endif
#source "drivers/input/finger"
```
